## CMakeLists.txt
```
# SPDX-License-Identifier: Apache-2.0
cmake_minimum_required(VERSION 3.20.0)
find_package(Zephyr REQUIRED HINTS $ENV{ZEPHYR_BASE})
project(tcm_ecc_test)

target_sources(app PRIVATE src/main.c)
```

## prj.conf
```kconfig
# Console to a RAM buffer, exported to Linux as remoteproc trace0.
# The DTCM ECC fix comes from the frdm-imx95 module (EXTRA_ZEPHYR_MODULES).
CONFIG_CONSOLE=y
CONFIG_RAM_CONSOLE=y
CONFIG_UART_CONSOLE=n
CONFIG_OPENAMP_RSC_TABLE=y
CONFIG_OPENAMP_RSC_TABLE_NUM_RPMSG_BUFF=0

# No drivers that talk to the System Manager, to isolate the TCM test
CONFIG_SERIAL=n
CONFIG_ARM_SCMI=n
CONFIG_MBOX=n
CONFIG_CLOCK_CONTROL=n
CONFIG_PINCTRL=n
```

## src/main.c
```c
/*
 * SPDX-License-Identifier: Apache-2.0
 */
#include <zephyr/kernel.h>

int main(void)
{
	uint32_t n = 0;

	printk("tcm_ecc_test: Hello World! %s\n", CONFIG_BOARD_TARGET);
	while (1) {
		k_msleep(1000);
		printk("alive %u\n", ++n);
	}
	return 0;
}
```
